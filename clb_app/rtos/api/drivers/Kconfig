## clb_app/rtos/api/drivers/Kconfig
```kconfig
menu "Device Drivers"

config ENABLE_DEVICE_IPC
    bool "Using device drivers IPC"
    default y

if ENABLE_DEVICE_IPC
    config PIPE_BUFFER_SIZE
        int "Set pipe buffer size"
        default 512
    
    config ENABLE_SYSTEM_WORKQUEUE
        bool "Using system default workqueue"
        default n

    if ENABLE_SYSTEM_WORKQUEUE
        config SYSTEM_WORKQUEUE_STACKSIZE
            int "The stack size for system workqueue thread"
            default 2048

    config SYSTEM_WORKQUEUE_PRIORITY
            int "The priority level of system workqueue thread"
            default 23
    endif
endif

config ENABLE_SERIAL
    bool "Using serial device drivers"
    select ENABLE_DEVICE_IPC
    select ENABLE_DEVICE
    default y

if ENABLE_SERIAL
    config DEV_SERIAL_ENABLE_DMA
        bool "Enable serial DMA mode"
        default y

    config DEV_SERIAL_RB_BUFSZ
        int "Set RX buffer size"
        default 64

endif

config ENABLE_CAN
    bool "Using CAN device drivers"
    default n

if ENABLE_CAN
    config DEV_CAN_ENABLE_HDR
        bool "Enable CAN hardware filter"
        default n
endif

config ENABLE_HWTIMER
    bool "Using hardware timer device drivers"
    default n

config ENABLE_CPUTIME
    bool "Enable CPU time for high resolution clock counter"
    default n
    help
        When enable this option, the BSP should provide a rt_clock_cputime_ops
        for CPU time by:
        const static struct rt_clock_cputime_ops _ops = {...};
        clock_cpu_setops(&_ops);

        Then user can use high resolution clock counter with:

        ts1 = clock_cpu_gettime();
        ts2 = clock_cpu_gettime();

        /* and get the ms of delta tick with API: */
        ms_tick = clock_cpu_millisecond(t2 - t1);
        us_tick = clock_cpu_microsecond(t2 - t1);

if ENABLE_CPUTIME
    config ENABLE_CPUTIME_CORTEXM
        bool "Use DWT for CPU time"
        default y
        depends on ARCH_ARM_CORTEX_M3 || ARCH_ARM_CORTEX_M4 || ARCH_ARM_CORTEX_M7
        help
            Some Cortex-M3/4/7 MCU has Data Watchpoint and Trace Register, use
            the cycle counter in DWT for CPU time.
endif

config ENABLE_I2C
    bool "Using I2C device drivers"
    default n

if ENABLE_I2C
    config DEV_I2C_DEBUG
        bool "Use I2C debug message"
        default n

    config ENABLE_I2C_BITOPS
        bool "Use GPIO to simulate I2C"
        default y

    if ENABLE_I2C_BITOPS
        config DEV_I2C_BITOPS_DEBUG
            bool "Use simulate I2C debug message"
            default n
    endif
endif

config ENABLE_PHY
    bool "Using ethernet phy device drivers"
    default n

config ENABLE_PIN
    bool "Using generic GPIO device drivers"
    default y

config ENABLE_ADC
    bool "Using ADC device drivers"
    default n

config ENABLE_DAC
    bool "Using DAC device drivers"
    default n
    
config ENABLE_PWM
    bool "Using PWM device drivers"
    default n

config ENABLE_MTD_NOR
    bool "Using MTD Nor Flash device drivers"
    default n

config ENABLE_MTD_NAND
    bool "Using MTD Nand Flash device drivers"
    default n

    if ENABLE_MTD_NAND
    config MTD_NAND_DEBUG
        bool "Enable MTD Nand operations debug information"
        default n
    endif

config ENABLE_PM
    bool "Using Power Management device drivers"
    default n

config ENABLE_RTC
    bool "Using RTC device drivers"
    default n

    if ENABLE_RTC
        config ENABLE_ALARM
            bool "Using RTC alarm"
            default n

        config ENABLE_SOFT_RTC
            bool "Using software simulation RTC device"
            default n

        config RTC_SYNC_ENABLE_NTP
            bool "Using NTP auto sync RTC time"
            depends on PKG_NETUTILS_NTP
            default y

            if RTC_SYNC_ENABLE_NTP
                config RTC_NTP_FIRST_SYNC_DELAY
                    int "NTP first sync delay time(second) for network connect"
                    default 30
                config RTC_NTP_SYNC_PERIOD
                    int "NTP auto sync period(second)"
                    default 3600
           endif
    endif

config ENABLE_SDIO
    bool "Using SD/MMC device drivers"
    default n

    if ENABLE_SDIO
        config SDIO_STACK_SIZE
            int "The stack size for sdio irq thread"
            default 512

        config SDIO_THREAD_PRIORITY
            int "The priority level value of sdio irq thread"
            default 15

        config MMCSD_STACK_SIZE
            int "The stack size for mmcsd thread"
            default 1024

        config MMCSD_THREAD_PREORITY
            int "The priority level value of mmcsd thread"
            default 22

        config MMCSD_MAX_PARTITION
            int "mmcsd max partition"
            default 16
        config SDIO_DEBUG
            bool "Enable SDIO debug log output"
        default n
    endif

config ENABLE_SPI
    bool "Using SPI Bus/Device device drivers"
    default n

    if ENABLE_SPI  
        config ENABLE_QSPI
            bool "Enable QSPI mode"
            default n

        config ENABLE_SPI_MSD
            bool "Using SD/TF card driver with spi"
            select ENABLE_DFS
            default n

        config ENABLE_SFUD
            bool "Using Serial Flash Universal Driver"
            default n
            help
                An using JEDEC's SFDP standard serial (SPI) flash universal driver library

            if ENABLE_SFUD
                config SFUD_ENABLE_SFDP
                bool "Using auto probe flash JEDEC SFDP parameter"
                default y

                config SFUD_ENABLE_FLASH_INFO_TABLE
                bool "Using defined supported flash chip information table"
                default y
                
                config SFUD_ENABLE_QSPI
                bool "Using QSPI mode support"
                select ENABLE_QSPI
                default n

                config SFUD_SPI_MAX_HZ
                int "Default spi maximum speed(HZ)"
                range 0 50000000
                default 50000000
                help
                    Read the JEDEC SFDP command must run at 50 MHz or less,and you also can use rt_spi_configure(); to config spi speed.

                config ENABLE_DEBUG_SFUD
                bool "Show more SFUD debug information"
                default n
            endif

        config ENABLE_ENC28J60
            bool "Using ENC28J60 SPI Ethernet network interface"
            select ENABLE_LWIP
            default n

        config ENABLE_SPI_WIFI
            bool "Using RW009/007 SPI Wi-Fi wireless interface"
            select ENABLE_LWIP
            default n
    endif

config ENABLE_WDT
    bool "Using Watch Dog device drivers"
    default n

config ENABLE_AUDIO
    bool "Using Audio device drivers"
    default n
    
    if ENABLE_AUDIO
        config AUDIO_REPLAY_MP_BLOCK_SIZE
            int "Replay memory pool block size"
            default 4096

        config AUDIO_REPLAY_MP_BLOCK_COUNT
            int "Replay memory pool block count"
            default 2

        config AUDIO_RECORD_PIPE_SIZE
            int "Record pipe size"
            default 2048
    endif

config ENABLE_SENSOR
    bool "Using Sensor device drivers"
    select ENABLE_PIN
    default n

if ENABLE_SENSOR
    config ENABLE_SENSOR_CMD
        bool "Using Sensor cmd"
        default y
endif

config ENABLE_TOUCH
    bool "Using Touch device drivers"
    default n
    if ENABLE_TOUCH
        config TOUCH_PIN_IRQ
        bool "touch irq use pin irq"
        default n
    endif

menuconfig ENABLE_HWCRYPTO
        bool "Using Hardware Crypto drivers"
        default n

    if ENABLE_HWCRYPTO
        config HARDWARE_CRYPTO_DEFAULT_NAME
            string "Hardware crypto device name"
            default "hwcryto"

        config HARDWARE_CRYPTO_IV_MAX_SIZE
            int "IV max size"
            default "16"

        config HARDWARE_CRYPTO_KEYBIT_MAX_SIZE
            int "Key max bit length"
            default 256

        config HARDWARE_CRYPTO_ENABLE_GCM
            bool "Using Hardware GCM"
            default n

        config HARDWARE_CRYPTO_ENABLE_AES
            bool "Using Hardware AES"
            default n

        if HARDWARE_CRYPTO_ENABLE_AES
            config HARDWARE_CRYPTO_ENABLE_AES_ECB
                bool "Using Hardware AES ECB mode"
                default y

            config HARDWARE_CRYPTO_ENABLE_AES_CBC
                bool "Using Hardware AES CBC mode"
                default n

            config HARDWARE_CRYPTO_ENABLE_AES_CFB
                bool "Using Hardware AES CFB mode"
                default n

            config HARDWARE_CRYPTO_ENABLE_AES_CTR
                bool "Using Hardware AES CTR mode"
                default n

            config HARDWARE_CRYPTO_ENABLE_AES_OFB
                bool "Using Hardware AES OFB mode"
                default n
        endif

        config HARDWARE_CRYPTO_ENABLE_DES
            bool "Using Hardware DES"
            default n

        if HARDWARE_CRYPTO_ENABLE_DES
            config HARDWARE_CRYPTO_ENABLE_DES_ECB
                bool "Using Hardware DES ECB mode"
                default y

            config HARDWARE_CRYPTO_ENABLE_DES_CBC
                bool "Using Hardware DES CBC mode"
                default n
        endif

        config HARDWARE_CRYPTO_ENABLE_3DES
            bool "Using Hardware 3DES"
            default n

        if HARDWARE_CRYPTO_ENABLE_3DES
            config HARDWARE_CRYPTO_ENABLE_3DES_ECB
                bool "Using Hardware 3DES ECB mode"
                default y

            config HARDWARE_CRYPTO_ENABLE_3DES_CBC
                bool "Using Hardware 3DES CBC mode"
                default n
        endif

        config HARDWARE_CRYPTO_ENABLE_RC4
            bool "Using Hardware RC4"
            default n

        config HARDWARE_CRYPTO_ENABLE_MD5
            bool "Using Hardware MD5"
            default n

        config HARDWARE_CRYPTO_ENABLE_SHA1
            bool "Using Hardware SHA1"
            default n

        config HARDWARE_CRYPTO_ENABLE_SHA2
            bool "Using Hardware SHA2"
            default n

        if HARDWARE_CRYPTO_ENABLE_SHA2
            config HARDWARE_CRYPTO_ENABLE_SHA2_224
                bool "Using Hardware SHA2_224 mode"
                default n

            config HARDWARE_CRYPTO_ENABLE_SHA2_256
                bool "Using Hardware SHA2_256 mode"
                default y

            config HARDWARE_CRYPTO_ENABLE_SHA2_384
                bool "Using Hardware SHA2_384 mode"
                default n

            config HARDWARE_CRYPTO_ENABLE_SHA2_512
                bool "Using Hardware SHA2_512 mode"
                default n
        endif

        config HARDWARE_CRYPTO_ENABLE_RNG
            bool "Using Hardware RNG"
            default n

        config HARDWARE_CRYPTO_ENABLE_CRC
            bool "Using Hardware CRC"
            default n

        if HARDWARE_CRYPTO_ENABLE_CRC
            config HARDWARE_CRYPTO_ENABLE_CRC_07
                bool "Using Hardware CRC-8 0x07 polynomial"
                default n

            config HARDWARE_CRYPTO_ENABLE_CRC_8005
                bool "Using Hardware CRC-16 0x8005 polynomial"
                default n

            config HARDWARE_CRYPTO_ENABLE_CRC_1021
                bool "Using Hardware CRC-16 0x1021 polynomial"
                default n

            config HARDWARE_CRYPTO_ENABLE_CRC_3D65
                bool "Using Hardware CRC-16 0x3D65 polynomial"
                default n

            config HARDWARE_CRYPTO_ENABLE_CRC_04C11DB7
                bool "Using Hardware CRC-32 0x04C11DB7 polynomial"
                default n
        endif

        config HARDWARE_CRYPTO_ENABLE_BIGNUM
            bool "Using Hardware bignum"
            default n

        if HARDWARE_CRYPTO_ENABLE_BIGNUM
            config HARDWARE_CRYPTO_ENABLE_BIGNUM_EXPTMOD
                bool "Using Hardware bignum expt_mod operation"
                default y

            config HARDWARE_CRYPTO_ENABLE_BIGNUM_MULMOD
                bool "Using Hardware bignum mul_mod operation"
                default y

            config HARDWARE_CRYPTO_ENABLE_BIGNUM_MUL
                bool "Using Hardware bignum mul operation"
                default n

            config HARDWARE_CRYPTO_ENABLE_BIGNUM_ADD
                bool "Using Hardware bignum add operation"
                default n

            config HARDWARE_CRYPTO_ENABLE_BIGNUM_SUB
                bool "Using Hardware bignum sub operation"
                default n
        endif
    endif

config ENABLE_PULSE_ENCODER
    bool "Using PULSE ENCODER device drivers"
    default n

config ENABLE_INPUT_CAPTURE
    bool "Using INPUT CAPTURE device drivers"
    default n

if ENABLE_INPUT_CAPTURE
    config INPUT_CAPTURE_RB_SIZE
        int "Set input capture ringbuffer size"
        default 100
endif

menuconfig ENABLE_WIFI
    bool "Using Wi-Fi framework"
    default n

    if ENABLE_WIFI
        config WLAN_DEVICE_STA_NAME
            string "The device name for station"
            default "wlan0"

        config WLAN_DEVICE_AP_NAME
            string "The device name for ap"
            default "wlan1"

        config WLAN_SSID_MAX_LENGTH
            int "SSID maximum length"
            default 32

        config WLAN_PASSWORD_MAX_LENGTH
            int "Password maximum length"
            default 32

        config WLAN_DEV_EVENT_NUM
            int "Driver events maxcount"
            default 2

        config WLAN_MANAGE_ENABLE
            bool "Connection management Enable"
            default y

        if WLAN_MANAGE_ENABLE
            config WLAN_SCAN_WAIT_MS
                int "Set scan timeout time(ms)"
                default 10000

            config WLAN_CONNECT_WAIT_MS
                int "Set connect timeout time(ms)"
                default 10000

            config WLAN_SCAN_SORT
                bool "Automatic sorting of scan results"
                default y

            config WLAN_MSH_CMD_ENABLE
                bool "MSH command Enable"
                default y

            config WLAN_AUTO_CONNECT_ENABLE
                bool "Auto connect Enable"
                select WLAN_CFG_ENABLE
                select WLAN_WORK_THREAD_ENABLE
                default y

            if WLAN_AUTO_CONNECT_ENABLE
                config AUTO_CONNECTION_PERIOD_MS
                    int "Auto connect period(ms)"
                    default 2000
            endif
        endif

        config WLAN_CFG_ENABLE
            bool "WiFi information automatically saved Enable"
            default y

        if WLAN_CFG_ENABLE
            config WLAN_CFG_INFO_MAX
                int "Maximum number of WiFi information automatically saved"
                default 3
        endif

        config WLAN_PROT_ENABLE
            bool "Transport protocol manage Enable"
            default y

        if WLAN_PROT_ENABLE
            config WLAN_PROT_NAME_LEN
                int "Transport protocol name length"
                default 8

            config WLAN_PROT_MAX
                int "Transport protocol maxcount"
                default 2

            config WLAN_DEFAULT_PROT
                string "Default transport protocol"
                default "lwip"

            config WLAN_PROT_LWIP_ENABLE
                bool "LWIP transport protocol Enable"
                select ENABLE_LWIP
                default y

            if WLAN_PROT_LWIP_ENABLE
                config WLAN_PROT_LWIP_NAME
                    string "LWIP transport protocol name"
                    default "lwip"

                config WLAN_PROT_LWIP_PBUF_FORCE
                    bool "Forced use of PBUF transmission"
                    default n
            endif
        endif

        config WLAN_WORK_THREAD_ENABLE
            bool "WLAN work queue thread Enable"
            default y

        if WLAN_WORK_THREAD_ENABLE
            config WLAN_WORKQUEUE_THREAD_NAME
                string "WLAN work queue thread name"
                default "wlan"

            config WLAN_WORKQUEUE_THREAD_SIZE
                int "WLAN work queue thread size"
                default 2048

            config WLAN_WORKQUEUE_THREAD_PRIO
                int "WLAN work queue thread priority"
                default 15
        endif

        menuconfig WLAN_DEBUG
            bool "Enable WLAN Debugging Options"
            default n

        if WLAN_DEBUG
            config WLAN_CMD_DEBUG
                bool "Enable Debugging of wlan_cmd.c"
                default n

            config WLAN_MGNT_DEBUG
                bool "Enable Debugging of wlan_mgnt.c"
                default n

            config WLAN_DEV_DEBUG
                bool "Enable Debugging of wlan_dev.c"
                default n

            config WLAN_PROT_DEBUG
                bool "Enable Debugging of wlan_prot.c"
                default n

            config WLAN_CFG_DEBUG
                bool "Enable Debugging of wlan_cfg.c"
                default n

            config WLAN_LWIP_DEBUG
                bool "Enable Debugging of wlan_lwip.c"
                default n
        endif
    endif

menu "Using USB"
    config ENABLE_USB_HOST
        bool "Using USB host"
        default n

        if ENABLE_USB_HOST
            config DEV_USBH_MSTORAGE
                bool "Enable Udisk Drivers"
                default n
                if DEV_USBH_MSTORAGE
                    config UDISK_MOUNTPOINT
                    string "Udisk mount dir"
                    default "/"
                endif
        endif
    config ENABLE_USB_DEVICE
        bool "Using USB device"
        default n
        if ENABLE_USB_DEVICE || ENABLE_USB_HOST
            config DEV_USBD_THREAD_STACK_SZ
                int "usb thread stack size"
                default 4096
        endif
        if ENABLE_USB_DEVICE
            config USB_VENDOR_ID
                hex "USB Vendor ID"
                default 0x0FFE
            config USB_PRODUCT_ID
                hex "USB Product ID"
                default 0x0001

            config DEV_USB_DEVICE_COMPOSITE
                bool "Enable composite device"
                default n
                choice
                    prompt "Device type"
                    default _RT_USB_DEVICE_NONE
                    depends on !DEV_USB_DEVICE_COMPOSITE
                    config _RT_USB_DEVICE_NONE
                        bool "Using custom class by register interface"
                        select DEV_USB_DEVICE_NONE
                    config _RT_USB_DEVICE_CDC
                        bool "Enable to use device as CDC device"
                        select DEV_USB_DEVICE_CDC
                    config _RT_USB_DEVICE_MSTORAGE
                        bool "Enable to use device as Mass Storage device"
                        select DEV_USB_DEVICE_MSTORAGE
                    config _RT_USB_DEVICE_HID
                        bool "Enable to use device as HID device"
                        select DEV_USB_DEVICE_HID
                    config _RT_USB_DEVICE_RNDIS
                        bool "Enable to use device as rndis device"
                        select DEV_USB_DEVICE_RNDIS
                        depends on ENABLE_LWIP
                    config _RT_USB_DEVICE_ECM
                        bool "Enable to use device as ecm device"
                        select DEV_USB_DEVICE_ECM
                        depends on ENABLE_LWIP
                    config _RT_USB_DEVICE_WINUSB
                        bool "Enable to use device as winusb device"
                        select DEV_USB_DEVICE_WINUSB
                    config _RT_USB_DEVICE_AUDIO
                        bool "Enable to use device as audio device"
                        select DEV_USB_DEVICE_AUDIO
                endchoice
                if DEV_USB_DEVICE_COMPOSITE
                    config DEV_USB_DEVICE_CDC
                        bool "Enable to use device as CDC device"
                        default n
                    config DEV_USB_DEVICE_NONE
                        bool
                        default y
                    config DEV_USB_DEVICE_MSTORAGE
                        bool "Enable to use device as Mass Storage device"
                        default n
                    config DEV_USB_DEVICE_HID
                        bool "Enable to use device as HID device"
                        default n
                    config DEV_USB_DEVICE_RNDIS
                        bool "Enable to use device as rndis device"
                        default n
                        depends on ENABLE_LWIP
                    config DEV_USB_DEVICE_ECM
                        bool "Enable to use device as ecm device"
                        default n
                        depends on ENABLE_LWIP
                    config DEV_USB_DEVICE_WINUSB
                        bool "Enable to use device as winusb device"
                        default n
                    config DEV_USB_DEVICE_AUDIO
                        bool "Enable to use device as audio device"
                        default n
                endif
                if DEV_USB_DEVICE_CDC
                    config DEV_VCOM_TASK_STK_SIZE
                        int "virtual com thread stack size"
                        default 512
                    config RT_CDC_RX_BUFSIZE
                        int "virtual com rx buffer size"
                        default 128
                    config DEV_VCOM_TX_USE_DMA
                        bool "Enable to use dma for vcom tx"
                        default n
                    config DEV_VCOM_SERNO
                        string "serial number of virtual com"
                        default "32021919830108"
                    config DEV_VCOM_SER_LEN
                        int "serial number length of virtual com"
                        default 14
                    config DEV_VCOM_TX_TIMEOUT
                        int "tx timeout(ticks) of virtual com"
                        default 1000
                endif
                if DEV_USB_DEVICE_WINUSB
                    config DEV_WINUSB_GUID
                    string "Guid for winusb"
                    default "{6860DC3C-C05F-4807-8807-1CA861CC1D66}"
                endif
                if DEV_USB_DEVICE_MSTORAGE
                    config DEV_USB_MSTORAGE_DISK_NAME
                    string "msc class disk name"
                    default "flash0"
                endif

                if DEV_USB_DEVICE_RNDIS
                    config RNDIS_DELAY_LINK_UP
                        bool "Delay linkup media connection"
                        select ENABLE_TIMER_SOFT
                        default n
                endif

                if DEV_USB_DEVICE_HID
                    config DEV_USB_DEVICE_HID_KEYBOARD
                        bool "Use to HID device as Keyboard"
                        default n
                    if DEV_USB_DEVICE_HID_KEYBOARD
                        config DEV_USB_DEVICE_HID_KEYBOARD_NUMBER
                        int "Number of Keyboard(max 3)"
                        default 1
                        range 1 3
                    endif
                    config DEV_USB_DEVICE_HID_MOUSE
                        bool "Use to HID device as Mouse"
                        default n
                    config DEV_USB_DEVICE_HID_GENERAL
                        bool "Use to HID device as General HID device"
                        default y
                        if DEV_USB_DEVICE_HID_GENERAL
                            config DEV_USB_DEVICE_HID_GENERAL_OUT_REPORT_LENGTH
                                int "General HID device out report length"
                                default 63
                                range 0 63

                            config DEV_USB_DEVICE_HID_GENERAL_IN_REPORT_LENGTH
                                int "General HID device in report length"
                                default 63
                                range 0 63
                        endif
                    config DEV_USB_DEVICE_HID_MEDIA
                        bool "Use to HID device as media keyboard"
                        default y
                endif
                if DEV_USB_DEVICE_AUDIO
                    config DEV_USB_DEVICE_AUDIO_MIC
                        bool "Use usb mic device as audio device"
                        default n
                        if DEV_USB_DEVICE_AUDIO_MIC
                            config DEV_USBD_MIC_DEVICE_NAME
                            string "audio mic device name"
                            default "mic0"
                        endif
                    config DEV_USB_DEVICE_AUDIO_SPEAKER
                        bool "Use usb speaker device as audio device"
                        default n
                        if DEV_USB_DEVICE_AUDIO_SPEAKER
                            config DEV_USBD_SPEAKER_DEVICE_NAME
                            string "audio speaker device name"
                            default "sound0"
                        endif
                endif
        endif
    endmenu
endmenu
```
